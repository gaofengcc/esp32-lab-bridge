## firmware/lvgl_screenshot/Kconfig
```kconfig
menu "LVGL 屏幕截图"

config LVGL_SCREENSHOT_ENABLE
    bool "启用 LVGL 屏幕截图"
    default n
    help
        启用后编译截图捕获与 BMP 编码逻辑。
        目标项目必须提供 LVGL、lvgl_port，并在 LVGL 配置中启用
        LV_USE_SNAPSHOT；否则请保持关闭。

        截图接口会在 LVGL 任务中读取当前活动屏幕，返回标准 24 位
        BGR bottom-up BMP。关闭时组件不编译 LVGL 源文件，并提供安全
        空桩接口。

endmenu
```

## wireless/diag_service/Kconfig
```kconfig
menu "diag_service"

config DIAG_SERVICE_TEST_AUTH_BYPASS
    bool "允许诊断服务鉴权旁路（仅实验室）"
    default n
    help
      开启后，受保护诊断路由不再校验 Authorization: Bearer 头。
      仅用于本地实验室联调，生产构建必须保持关闭。

config DIAG_SERVICE_HTTPD_STACK_SIZE
    int "诊断 HTTP 服务任务栈大小"
    default 12288
    range 4096 32768
    help
      设置 ESP-IDF HTTP 服务任务的栈大小，单位为字节。
      自检、日志和 OTA 回调可能需要高于默认值的栈空间。

config DIAG_SERVICE_HTTPD_MAX_URI_HANDLERS
    int "诊断 HTTP 服务 URI 路由槽位数"
    default 12
    range 9 32
    help
      设置 HTTP 服务可注册的 URI 路由数量。
      当前内置路由包含健康检查、状态、自检、日志、截图、OTA 和重启，
      如业务侧复用同一 HTTP 服务注册其他路由，请预留额外槽位。

endmenu
```

## wireless/ota_update/Kconfig
```kconfig
menu "ota_update"

config OTA_UPDATE_MANIFEST_MAX_LEN
    int "OTA manifest 最大长度"
    default 4096
    range 1024 16384
    help
      组件下载 manifest 时使用的最大缓冲区大小（字节）。

config OTA_UPDATE_HTTP_TIMEOUT_MS
    int "OTA HTTP 超时时间"
    default 15000
    range 1000 60000
    help
      manifest 和 bin 下载使用的 HTTP 超时时间（毫秒）。

config OTA_UPDATE_HTTP_READ_BUF_SIZE
    int "OTA HTTP 读缓冲大小"
    default 4096
    range 1024 8192
    help
      OTA bin 下载时的单次读取缓冲区大小（字节）。

endmenu
```
